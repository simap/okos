
testsourcecode code 0x800
   db 0x24, 0x0b
   db 0x15, 0x12
   db 0x17, 0x14
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   db 0x25, 0x28
    
    
    ;testing example blink program assembled by mplabx
testexecutable code 0x1000
example_compiled_blink:
    ;blink led test program
   ;uses file 2 offsets
   ; set tmr0 as 16bit 1;256
   movlw 0x87
   movwf T0CON

   ;port a to out low
   movlw 0
   movwf LATA ;lata
   movwf TRISA ;trisa

   ;turn off the 74hc138
   ;b6 out low
   bcf LATB, 6 ;latb
   bcf TRISB, 6 ;trisb

   ;c0 out high. sct2024 clk
   bsf LATC, 0 ;latc
   bcf TRISC, 0 ;trisc

   ;clock out 15 low leds
   movlw 0xf
   movwf 0x3A,0   ;temp var

   ;start of init loop
blinkinitloop:
   bcf LATC, 0
   bsf LATC, 0 ;pulse clk on c0
   movlw 0xff   ;negative 1
   addwf 0x3a, 1, 0 ;add into temp
   btfss STATUS, 2 ;status z
   goto blinkinitloop ;2nd file 11th word

   ;clock out 1 high led
   bsf LATA, 6 ;lata
   bcf LATC, 0 ;pulse clk on c0
   bsf LATC, 0

   ;toggle 74hc138 en based on
   ;tmr0h 7th bit. about 700ms
   ;start of blink loop
blinkmainloop:
   btfss TMR0H, 7 ;tmr0h
   bcf LATB, 6 ;latb
   btfsc TMR0H, 7 ;tmr0h
   bsf LATB, 6 ;latb

   ;loop forever
   goto blinkmainloop ;2nd file 20th word
